## config/west.yml
```yaml
manifest:
  remotes:
    - name: zmkfirmware
      url-base: https://github.com/zmkfirmware
    - name: tklzg 
      url-base: https://github.com/tklzg
  projects:
    - name: zmk
      remote: zklzg
      revision: encoders
      import: app/west.yml
  self:
    path: config
```
